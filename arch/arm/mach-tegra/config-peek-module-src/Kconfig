## arch/arm/mach-tegra/config-peek-module-src/Kconfig
```kconfig
config PINMUXDUMPER
	tristate "Tegra2 realtime pinmux dumper"
	depends on ARCH_TEGRA_2x_SOC && DEBUG_FS
	default M
	---help---
	  Enable support for dumping in realtime the pinmux config of Tegra2
```
